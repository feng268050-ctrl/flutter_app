// ynh960: USB host for 1 mm pin-header expansion (HID keyboard, etc.).
//
// Innohi customer_board_ynh960 enables usbhost_dwc3 on u2phy0_host + combphy1
// (HS-only). Earlier plug-ssh work blanketed these nodes off so OTG gadget
// alone owned usb2phy0 — incorrect once expansion USB is required.
//
// Micro-USB OTG dual-role (ID) is in ynh960-usb-gadget.dtsi —
// independent of this expansion host controller.
// USB_HOST_PWREN* VBUS GPIOs are restored in ynh960-own-gpio.dtsi
// (gpio4 PA0/PA1/PA2 free under RMII; were stolen by EVB RGMII).

&u2phy0_host {
	status = "okay";
};

&usbhost_dwc3 {
	phys = <&u2phy0_host>;
	phy-names = "usb2-phy";
	maximum-speed = "high-speed";
	status = "okay";
};

&combphy1_usq {
	rockchip,dis-u3otg1-port;
	status = "okay";
};
