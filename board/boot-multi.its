## board/boot-multi.its
```
/*
 * lws-hmi: multi-configuration boot FIT (platform W5).
 * Generated by scripts/generate-boot-fit-its.sh — do not hand-edit;
 * change board/rk356x-fit-boards.txt and regenerate.
 *
 * Shared kernel + resource; one flat_dt + named conf per inventory board_id.
 * Default conf == product board_id (ynh960). Startup DT stays in FIT (not OEM).
 */
/dts-v1/;
/ {
    description = "U-Boot FIT multi-DT for rk356x family";

    images {
        kernel {
            data = /incbin/("@KERNEL_IMG@");
            type = "kernel";
            arch = "arm64";
            os = "linux";
            compression = "none";
            entry = <0xffffff01>;
            load = <0xffffff01>;

            hash {
                algo = "sha256";
            };
        };

        resource {
            data = /incbin/("@RESOURCE_IMG@");
            type = "multi";
            arch = "arm64";
            compression = "none";

            hash {
                algo = "sha256";
            };
        };

        fdt-ynh960 {
            data = /incbin/("@KERNEL_DTB@");
            type = "flat_dt";
            arch = "arm64";
            compression = "none";
            load = <0xffffff00>;

            hash {
                algo = "sha256";
            };
        };

    };

    configurations {
        default = "ynh960";

        ynh960 {
            description = "board_id=ynh960";
            rollback-index = <0x00>;
            fdt = "fdt-ynh960";
            kernel = "kernel";
            multi = "resource";

            signature {
                algo = "sha256,rsa2048";
                padding = "pss";
                key-name-hint = "dev";
                sign-images = "fdt", "kernel", "multi";
            };
        };
    };
};
```

## board/boot-slim.its
```
/*
 * Legacy single-FDT slim FIT (no resource.img). Superseded for product builds by
 * board/boot-multi.its (W5 multi-conf; see board/rk356x-fit-boards.txt).
 * Kept for reference / size experiments only — lunch uses RK_BOOT_FIT_ITS_NAME=boot-multi.its.
 */
/dts-v1/;
/ {
    description = "U-Boot FIT source file for arm";

    images {
        fdt {
            data = /incbin/("@KERNEL_DTB@");
            type = "flat_dt";
            arch = "arm64";
            compression = "none";
            load = <0xffffff00>;

            hash {
                algo = "sha256";
            };
        };

        kernel {
            data = /incbin/("@KERNEL_IMG@");
            type = "kernel";
            arch = "arm64";
            os = "linux";
            compression = "none";
            entry = <0xffffff01>;
            load = <0xffffff01>;

            hash {
                algo = "sha256";
            };
        };
    };

    configurations {
        default = "conf";

        conf {
            rollback-index = <0x00>;
            fdt = "fdt";
            kernel = "kernel";
        };
    };
};
```
