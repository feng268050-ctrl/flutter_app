// lws-hmi ynh960: product touch IC is Goodix GT9xx on i2c1 @0x5d.
// Focaltech @0x38 NACKs on hardware (dmesg: i2c_transfer ret=-6, then
// "not focal IC, unregister driver"). Sitronix has no driver in this tree.
// IRQ/RST GPIOs are shared (GPIO0_PB5 / GPIO0_PB6) — only one node may be okay.
// Resolution comes from Innohi goodix,cfg-group (800×1280).

&focaltech {
	status = "disabled";
};

&i2c1 {
	sitronix@55 {
		status = "disabled";
	};

	goodix_ts@5d {
		status = "okay";
	};
};
