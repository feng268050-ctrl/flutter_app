// Generated from board/lcd_mipi_param.txt — do not edit; run scripts/gen-ynh960-panel-init-dtsi.sh

&dsi0_panel {
	panel-init-sequence-size = <1007>;
	panel-init-sequence = [
		15 00 02 E0 00
		15 00 02 E1 93
		15 00 02 E2 65
		15 00 02 E3 F8
		15 00 02 80 03
		15 00 02 E0 01
		15 00 02 00 00
		15 00 02 01 3D
		15 00 02 03 10
		15 00 02 04 43
		15 00 02 0C 74
		15 00 02 17 00
		15 00 02 18 EF
		15 00 02 19 01
		15 00 02 1A 00
		15 00 02 1B EF
		15 00 02 1C 01
		15 00 02 24 FE
		15 00 02 37 09
		15 00 02 38 04
		15 00 02 39 08
		15 00 02 3A 12
		15 00 02 3C 78
		15 00 02 3D FF
		15 00 02 3E FF
		15 00 02 3F 7F
		15 00 02 40 06
		15 00 02 41 A0
		15 00 02 43 14
		15 00 02 44 11
		15 00 02 45 24
		15 00 02 55 02
		15 00 02 57 69
		15 00 02 59 0A
		15 00 02 5A 29
		15 00 02 5B 10
		15 00 02 5D 70
		15 00 02 5E 5B
		15 00 02 5F 4B
		15 00 02 60 3F
		15 00 02 61 3B
		15 00 02 62 2D
		15 00 02 63 2F
		15 00 02 64 18
		15 00 02 65 2F
		15 00 02 66 2C
		15 00 02 67 2B
		15 00 02 68 47
		15 00 02 69 34
		15 00 02 6A 3B
		15 00 02 6B 2E
		15 00 02 6C 2A
		15 00 02 6D 1F
		15 00 02 6E 11
		15 00 02 6F 02
		15 00 02 70 70
		15 00 02 71 5B
		15 00 02 72 4B
		15 00 02 73 3F
		15 00 02 74 3B
		15 00 02 75 2D
		15 00 02 76 2F
		15 00 02 77 18
		15 00 02 78 2F
		15 00 02 79 2C
		15 00 02 7A 2B
		15 00 02 7B 47
		15 00 02 7C 34
		15 00 02 7D 3B
		15 00 02 7E 2E
		15 00 02 7F 2A
		15 00 02 80 1F
		15 00 02 81 11
		15 00 02 82 02
		15 00 02 E0 02
		15 00 02 00 5E
		15 00 02 01 5F
		15 00 02 02 57
		15 00 02 03 58
		15 00 02 04 48
		15 00 02 05 4A
		15 00 02 06 44
		15 00 02 07 46
		15 00 02 08 40
		15 00 02 09 5F
		15 00 02 0A 5F
		15 00 02 0B 5F
		15 00 02 0C 5F
		15 00 02 0D 5F
		15 00 02 0E 5F
		15 00 02 0F 42
		15 00 02 10 5F
		15 00 02 11 5F
		15 00 02 12 5F
		15 00 02 13 5F
		15 00 02 14 5F
		15 00 02 15 5F
		15 00 02 16 5E
		15 00 02 17 5F
		15 00 02 18 57
		15 00 02 19 58
		15 00 02 1A 49
		15 00 02 1B 4B
		15 00 02 1C 45
		15 00 02 1D 47
		15 00 02 1E 41
		15 00 02 1F 5F
		15 00 02 20 5F
		15 00 02 21 5F
		15 00 02 22 5F
		15 00 02 23 5F
		15 00 02 24 5F
		15 00 02 25 43
		15 00 02 26 5F
		15 00 02 27 5F
		15 00 02 28 5F
		15 00 02 29 5F
		15 00 02 2A 5F
		15 00 02 2B 5F
		15 00 02 2C 1F
		15 00 02 2D 1E
		15 00 02 2E 17
		15 00 02 2F 18
		15 00 02 30 07
		15 00 02 31 05
		15 00 02 32 0B
		15 00 02 33 09
		15 00 02 34 03
		15 00 02 35 1F
		15 00 02 36 1F
		15 00 02 37 1F
		15 00 02 38 1F
		15 00 02 39 1F
		15 00 02 3A 1F
		15 00 02 3B 01
		15 00 02 3C 1F
		15 00 02 3D 1F
		15 00 02 3E 1F
		15 00 02 3F 1F
		15 00 02 40 1F
		15 00 02 41 1F
		15 00 02 42 1F
		15 00 02 43 1E
		15 00 02 44 17
		15 00 02 45 18
		15 00 02 46 06
		15 00 02 47 04
		15 00 02 48 0A
		15 00 02 49 08
		15 00 02 4A 02
		15 00 02 4B 1F
		15 00 02 4C 1F
		15 00 02 4D 1F
		15 00 02 4E 1F
		15 00 02 4F 1F
		15 00 02 50 1F
		15 00 02 51 00
		15 00 02 52 1F
		15 00 02 53 1F
		15 00 02 54 1F
		15 00 02 55 1F
		15 00 02 56 1F
		15 00 02 57 1F
		15 00 02 58 40
		15 00 02 5B 30
		15 00 02 5C 07
		15 00 02 5D 30
		15 00 02 5E 01
		15 00 02 5F 02
		15 00 02 60 30
		15 00 02 61 03
		15 00 02 62 04
		15 00 02 63 6A
		15 00 02 64 6A
		15 00 02 65 35
		15 00 02 66 0D
		15 00 02 67 73
		15 00 02 68 0B
		15 00 02 69 6A
		15 00 02 6A 6A
		15 00 02 6B 08
		15 00 02 6C 00
		15 00 02 6D 04
		15 00 02 6E 00
		15 00 02 6F 88
		15 00 02 75 BC
		15 00 02 76 00
		15 00 02 77 0D
		15 00 02 78 1B
		15 00 02 E0 04
		15 00 02 00 0E
		15 00 02 02 B3
		15 00 02 09 60
		15 00 02 0E 4A
		15 00 02 37 58
		15 00 02 2B 0F
		15 00 02 E0 05
		15 00 02 15 1D
		15 00 02 E0 00
		05 00 01 35
		05 78 01 11
		05 32 01 29
	];
};

