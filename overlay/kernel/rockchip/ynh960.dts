// ynh960 board device tree (FIT conf / board_id = ynh960).
// Git source of truth: overlay/kernel/rockchip/ynh960.dts — synced by make apply-overlay.
// SPDX-License-Identifier: (GPL-2.0+ OR MIT)
/*
 * Copyright (c) 2020 Rockchip Electronics Co., Ltd.
 *
 */

#include "rk3566-evb2-lp4x-v10.dtsi"
#include "rk3568-linux.dtsi"
#include "customer_board_ynh960.dtsi"
#include "customer.dtsi"
