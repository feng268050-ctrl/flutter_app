// SPDX-License-Identifier: (GPL-2.0+ OR MIT)
// ek3562 MIPI panel — captured from lab board live FDT (2026-08-15).
// bootargs lcdtype=2 selects the vendor 7" table (7-panel-init-sequence).
// Native timing was timingzero: 800x1280 @ 67 MHz.
// Overrides Rockchip EVB reference 1080x1920 in rk3562-evb.dtsi.
// Not the same panel as ynh960 (same resolution, different init/porch).
#include <dt-bindings/display/drm_mipi_dsi.h>

&dsi_panel {
	status = "okay";
	enable-delay-ms = <60>;
	prepare-delay-ms = <60>;
	reset-delay-ms = <60>;
	init-delay-ms = <60>;
	unprepare-delay-ms = <60>;
	disable-delay-ms = <60>;
	mipi-data-delay-ms = <60>;
	width-mm = <68>;
	height-mm = <121>;
	dsi,flags = <0xa03>;
	dsi,format = <MIPI_DSI_FMT_RGB888>;
	dsi,lanes = <4>;
	panel-init-sequence-size = <998>;
	panel-init-sequence = [
		29 00 04 ff 98 81 03
		13 00 02 01 00
		13 00 02 02 00
		13 00 02 03 72
		13 00 02 04 00
		13 00 02 05 00
		13 00 02 06 09
		13 00 02 07 00
		13 00 02 08 00
		13 00 02 09 00
		13 00 02 0a 00
		13 00 02 0b 00
		13 00 02 0c 00
		13 00 02 0d 00
		13 00 02 0e 00
		13 00 02 0f 00
		13 00 02 10 00
		13 00 02 11 00
		13 00 02 12 00
		13 00 02 13 00
		13 00 02 14 00
		13 00 02 15 00
		13 00 02 16 00
		13 00 02 17 00
		13 00 02 18 00
		13 00 02 19 00
		13 00 02 1a 00
		13 00 02 1b 00
		13 00 02 1c 00
		13 00 02 1d 00
		13 00 02 1e 40
		13 00 02 1f 80
		13 00 02 20 05
		13 00 02 21 02
		13 00 02 22 00
		13 00 02 23 00
		13 00 02 24 00
		13 00 02 25 00
		13 00 02 26 00
		13 00 02 27 00
		13 00 02 28 33
		13 00 02 29 22
		13 00 02 2a 00
		13 00 02 2b 00
		13 00 02 2c 00
		13 00 02 2d 00
		13 00 02 2e 00
		13 00 02 2f 00
		13 00 02 30 00
		13 00 02 31 00
		13 00 02 32 00
		13 00 02 33 00
		13 00 02 34 04
		13 00 02 35 00
		13 00 02 36 00
		13 00 02 37 00
		13 00 02 38 3c
		13 00 02 39 00
		13 00 02 3a 00
		13 00 02 3b 00
		13 00 02 3c 00
		13 00 02 3d 00
		13 00 02 3e 00
		13 00 02 3f 00
		13 00 02 40 00
		13 00 02 41 00
		13 00 02 42 00
		13 00 02 43 00
		13 00 02 44 00
		13 00 02 50 10
		13 00 02 51 32
		13 00 02 52 54
		13 00 02 53 76
		13 00 02 54 98
		13 00 02 55 ba
		13 00 02 56 10
		13 00 02 57 32
		13 00 02 58 54
		13 00 02 59 76
		13 00 02 5a 98
		13 00 02 5b ba
		13 00 02 5c dc
		13 00 02 5d fe
		13 00 02 5e 00
		13 00 02 5f 01
		13 00 02 60 00
		13 00 02 61 15
		13 00 02 62 14
		13 00 02 63 0e
		13 00 02 64 0f
		13 00 02 65 0c
		13 00 02 66 0d
		13 00 02 67 06
		13 00 02 68 02
		13 00 02 69 02
		13 00 02 6a 02
		13 00 02 6b 02
		13 00 02 6c 02
		13 00 02 6d 02
		13 00 02 6e 07
		13 00 02 6f 02
		13 00 02 70 02
		13 00 02 71 02
		13 00 02 72 02
		13 00 02 73 02
		13 00 02 74 02
		13 00 02 75 01
		13 00 02 76 00
		13 00 02 77 14
		13 00 02 78 15
		13 00 02 79 0e
		13 00 02 7a 0f
		13 00 02 7b 0c
		13 00 02 7c 0d
		13 00 02 7d 06
		13 00 02 7e 02
		13 00 02 7f 02
		13 00 02 80 02
		13 00 02 81 02
		13 00 02 82 02
		13 00 02 83 02
		13 00 02 84 07
		13 00 02 85 02
		13 00 02 86 02
		13 00 02 87 02
		13 00 02 88 02
		13 00 02 89 02
		13 00 02 8a 02
		29 00 04 ff 98 81 04
		13 00 02 6e 2a
		13 00 02 6f 35
		13 00 02 3a 24
		13 00 02 8d 14
		13 00 02 87 ba
		13 00 02 26 76
		13 00 02 b2 d1
		13 00 02 b5 27
		13 00 02 31 75
		13 00 02 30 03
		13 00 02 3b 98
		13 00 02 35 1f
		13 00 02 33 14
		13 00 02 7a 0f
		13 00 02 38 01
		13 00 02 39 00
		29 00 04 ff 98 81 01
		13 00 02 22 0a
		13 00 02 31 00
		13 00 02 53 45
		13 00 02 55 4e
		13 00 02 50 c7
		13 00 02 51 c2
		13 00 02 60 22
		13 00 02 63 00
		13 00 02 a0 00
		13 00 02 a1 18
		13 00 02 a2 27
		13 00 02 a3 14
		13 00 02 a4 17
		13 00 02 a5 2a
		13 00 02 a6 1e
		13 00 02 a7 20
		13 00 02 a8 90
		13 00 02 a9 1c
		13 00 02 aa 28
		13 00 02 ab 84
		13 00 02 ac 1f
		13 00 02 ad 21
		13 00 02 ae 55
		13 00 02 af 2a
		13 00 02 b0 2d
		13 00 02 b1 52
		13 00 02 b2 5c
		13 00 02 b3 23
		13 00 02 c0 00
		13 00 02 c1 18
		13 00 02 c2 27
		13 00 02 c3 14
		13 00 02 c4 17
		13 00 02 c5 2a
		13 00 02 c6 1e
		13 00 02 c7 20
		13 00 02 c8 90
		13 00 02 c9 1c
		13 00 02 ca 28
		13 00 02 cb 84
		13 00 02 cc 1f
		13 00 02 cd 21
		13 00 02 ce 55
		13 00 02 cf 2a
		13 00 02 d0 2d
		13 00 02 d1 52
		13 00 02 d2 5c
		13 00 02 d3 23
		29 00 04 ff 98 81 00
		13 00 02 11 00
		13 78 02 29 00
		13 00 02 35 00
	];
	/*
	 * Live FDT named panel-exit-sequence = <0x05780111 0x051e0129>
	 * (sleep-out / display-on) — almost certainly mislabeled; init already
	 * ends with 0x11 / 0x29. Use standard display-off / sleep-in here.
	 */
	panel-exit-sequence = [
		05 00 01 28
		05 00 01 10
	];

	display-timings {
		native-mode = <&ek3562_mipi_timing>;
		ek3562_mipi_timing: timing {
			clock-frequency = <67000000>;
			hactive = <800>;
			vactive = <1280>;
			hfront-porch = <18>;
			hsync-len = <18>;
			hback-porch = <18>;
			vfront-porch = <20>;
			vsync-len = <4>;
			vback-porch = <10>;
			hsync-active = <0>;
			vsync-active = <0>;
			de-active = <0>;
			pixelclk-active = <0>;
		};
	};
};
